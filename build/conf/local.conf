## build/conf/local.conf
```bitbake
MACHINE ??= "stm32mp157f-dk2"

DISTRO ?= "poky"

PACKAGE_CLASSES ?= "package_ipk"

EXTRA_IMAGE_FEATURES ?= "debug-tweaks"

PATCHRESOLVE = "noop"

BB_DISKMON_DIRS ??= "\
    STOPTASKS,${TMPDIR},1G,100K \
    STOPTASKS,${DL_DIR},1G,100K \
    STOPTASKS,${SSTATE_DIR},1G,100K \
    STOPTASKS,/tmp,100M,100K \
    HALT,${TMPDIR},100M,1K \
    HALT,${DL_DIR},100M,1K \
    HALT,${SSTATE_DIR},100M,1K \
    HALT,/tmp,10M,1K"

CONF_VERSION = "2"
```

## meta-roslynos-distro/conf/distro/roslynos.conf
```bitbake
require conf/distro/poky.conf

DISTRO = "roslynos"
DISTRO_NAME = "RoslynOS Linux"
DISTRO_VERSION ?= "${@ '0.0.0-dev' if not d.getVar('SOURCECODE_VERSION') else d.getVar('SOURCECODE_VERSION') }"
DISTRO_CODENAME = "roslynos-kirkstone"
SDK_VENDOR = "-roslynossdk"
SDK_VERSION = "${@d.getVar('DISTRO_VERSION').replace('snapshot-${DATE}', 'snapshot')}"

MAINTAINER ?= "Bytewizer <bytewizer@gmail.com>"
TARGET_VENDOR = "-bytewizer"

# Default Software features shipped 
POKY_DEFAULT_DISTRO_FEATURES = "wifi opengl"
# DISTRO_FEATURES = "opengl wifi"

# Extra image configuration defaults
IMAGE_FEATURES ?= "ssh-server-openssh"

# Enable systemd
INIT_MANAGER = "systemd"

DISTRO_FEATURES:append = " systemd"
VIRTUAL-RUNTIME_init_manager = "systemd"
VIRTUAL-RUNTIME_login_manager = "shadow-base"

# Prevent the SysVinit feature from being automatically enabled
DISTRO_FEATURES_BACKFILL_CONSIDERED = "sysvinit"

# Using systemd-journald without syslog daemon
VIRTUAL-RUNTIME_syslog = ""
VIRTUAL-RUNTIME_base-utils-syslog = ""

# Remove initscripts from image
VIRTUAL-RUNTIME_initscripts = ""

# Set hostname
hostname:pn-base-files = "maui"
```

## meta-roslynos-distro/conf/layer.conf
```bitbake
# We have a conf and classes directory, add to BBPATH
BBPATH .= ":${LAYERDIR}"

# We have recipes-* directories, add to BBFILES
BBFILES += "${LAYERDIR}/recipes-*/*/*.bb \
            ${LAYERDIR}/recipes-*/*/*.bbappend"

BBFILE_COLLECTIONS += "meta-roslynos-distro"
BBFILE_PATTERN_meta-roslynos-distro= "^${LAYERDIR}/"
BBFILE_PRIORITY_meta-roslynos-distro= "6"

LAYERDEPENDS_meta-roslynos-distro = "core"
LAYERSERIES_COMPAT_meta-roslynos-distro = "kirkstone"
```

## meta-roslynos-distro/recipes-core/base-files/files/defconfig
```kconfig
CONFIG_INPUT_TOUCHSCREEN=y
CONFIG_OF_TOUCHSCREEN=y
CONFIG_TOUCHSCREEN_RPI_FT5406=m
```

## meta-stm32-oss/conf/layer.conf
```bitbake
# We have a conf and classes directory, add to BBPATH
BBPATH .= ":${LAYERDIR}"

# We have recipes-* directories, add to BBFILES
BBFILES += "${LAYERDIR}/recipes-*/*/*.bb \
	${LAYERDIR}/recipes-*/*/*.bbappend"

BBFILE_COLLECTIONS += "meta-stm32-oss"
BBFILE_PATTERN_meta-stm32-oss  = "^${LAYERDIR}/"
BBFILE_PRIORITY_meta-stm32-oss = "10"

LAYERDEPENDS_meta-stm32-oss = "core"
LAYERSERIES_COMPAT_meta-stm32-oss = "kirkstone"
```
